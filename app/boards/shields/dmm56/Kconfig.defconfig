## app/boards/shields/dmm56/Kconfig.defconfig
```kconfig
# Copyright (c) 2020 Ryan Cross
# SPDX-License-Identifier: MIT

if SHIELD_DMM56

config ZMK_KEYBOARD_NAME
	default "DMM56"
	
endif
```

## app/boards/shields/dmm56/Kconfig.shield
```kconfig
# Copyright (c) 2020 Ryan Cross
# SPDX-License-Identifier: MIT

config SHIELD_DMM56
	def_bool $(shields_list_contains,dmm56)
```
